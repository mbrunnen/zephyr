## CMakeLists.txt
```
# SPDX-License-Identifier: Apache-2.0

cmake_minimum_required(VERSION 3.20.0)

find_package(Zephyr COMPONENTS unittest REQUIRED HINTS $ENV{ZEPHYR_BASE})

project(led_strip)

add_library(mocks STATIC src/mocks/gpio.c)
target_include_directories(mocks PUBLIC src/mocks)
target_link_libraries(mocks PRIVATE test_interface)

target_sources(testbinary PRIVATE src/main.c)
target_link_libraries(testbinary PUBLIC mocks)
```

## prj.conf
```kconfig
CONFIG_ZTEST=y
CONFIG_ZTEST_NEW_API=y
CONFIG_LED_STRIP=y
CONFIG_GPIO=y
CONFIG_WS2812_STRIP=y
CONFIG_WS2812_STRIP_GPIO=y
```

## boards/native_posix.overlay
```dts
/* SPDX-License-Identifier: Apache-2.0 */

#include <zephyr/dt-bindings/gpio/gpio.h>
#include <zephyr/dt-bindings/led/led.h>

/ {
	led_strip: sk68xx {
		compatible = "worldsemi,ws2812-gpio";
		chain-length = <1>;
		color-mapping = <LED_COLOR_ID_GREEN
				LED_COLOR_ID_RED
				LED_COLOR_ID_BLUE>;
		in-gpios = <&gpio0 0 0>;
	};
};
```

## src/main.c
```c
/* SPDX-License-Identifier: Apache-2.0 */

#include <zephyr/ztest.h>
#include <zephyr/fff.h>
#include <zephyr/device.h>
#include <zephyr/drivers/led_strip.h>

DEFINE_FFF_GLOBALS;

struct ws2812_gpio_fixture {
	const struct device *dev;
};

static void *ws2812_gpio_setup(void)
{
	static struct ws2812_gpio_fixture fixture = {
		.dev = DEVICE_DT_GET(DT_NODELABEL(led_strip)),
	};

	zassert_not_null(fixture.dev);
	return &fixture;
}

uint32_t k_cycle_get_32_delegate(void)
{
	static uint32_t clock = 0;
	clock += 100;
	return clock;
}

ZTEST_SUITE(ws2812_gpio, NULL, ws2812_gpio_setup, NULL, NULL, NULL);

#define RGB(_r, _g, _b)                                                                            \
	{                                                                                          \
		.r = (_r), .g = (_g), .b = (_b)                                                    \
	}

FAKE_VOID_FUNC(ws2812_gpio_delay, uint32_t);
FAKE_VALUE_FUNC(uint32_t, k_cycle_get_32);

ZTEST_F(ws2812_gpio, test_delay)
{
	int rc = 0;
	k_cycle_get_32_fake.custom_fake = k_cycle_get_32_delegate;
	struct led_rgb pixels[] = {
		RGB(0x0f, 0x00, 0x00),
		RGB(0x00, 0x0f, 0x00),
		RGB(0x00, 0x00, 0x0f),
	};

	rc = led_strip_update_rgb(fixture->dev, pixels, ARRAY_SIZE(pixels));
	TC_PRINT("%d", ws2812_gpio_delay_fake.call_count);
	zassert_equal(ws2812_gpio_delay_fake.call_count, 1);
}
```
